## arch/arm64/configs/RE58C2-los21_defconfig
```kconfig
CONFIG_ANDROID=y
CONFIG_ANDROID_BINDER_IPC=y
CONFIG_ANDROID_BINDER_DEVICES="binder,hwbinder,vndbinder"
CONFIG_ANDROID_BINDERFS=y
CONFIG_ANDROID_BINDERFS_NAME_MAX=255

CONFIG_ANDROID_VENDOR_HOOKS=y
CONFIG_GKI_HIDDEN=y
CONFIG_GKI_SHIPPING_VERSION=14

CONFIG_DM_VERITY=y
CONFIG_DM_VERITY_FEC=y
CONFIG_DM_VERITY_AVB=y
CONFIG_AVB=y
CONFIG_LIBAVB=y

CONFIG_ANDROID_ION=y
CONFIG_ION=y

CONFIG_ASHMEM=y

CONFIG_TMPFS=y
CONFIG_TMPFS_POSIX_ACL=y
CONFIG_TMPFS_XATTR=y
CONFIG_DEVTMPFS=y
CONFIG_DEVTMPFS_MOUNT=y
CONFIG_FHANDLE=y
CONFIG_SYSVIPC=y

CONFIG_EXT4_FS=y
CONFIG_F2FS_FS=y
CONFIG_EROFS_FS=y

CONFIG_DEBUG_FS=y
CONFIG_PANIC_ON_OOPS=y
CONFIG_PSTORE=y
CONFIG_PSTORE_CONSOLE=y
CONFIG_PSTORE_RAM=y
CONFIG_SCHED_DEBUG=y

CONFIG_USB_GADGET=y
CONFIG_USB_CONFIGFS=y
CONFIG_USB_CONFIGFS_F_FS=y
CONFIG_USB_CONFIGFS_UEVENT=y
CONFIG_USB_FUNCTIONFS=y
CONFIG_USB_FUNCTIONFS_GENERIC=y

CONFIG_MODULES=y
CONFIG_KALLSYMS=y

CONFIG_SECURITY=y
CONFIG_CRYPTO_SHA256=y

CONFIG_ARM64=y
CONFIG_BUILD_ARM64_DT_OVERLAY=y
```
